## fs/cgroupfs/Kconfig
```kconfig
# SPDX-License-Identifier: GPL-2.0-only
config CGROUPFS
	bool "cgroupfs file system support"
	default n
	depends on X86 && CGROUPS && SYSFS && CFS_BANDWIDTH && CPUSETS
	help
	The cgroupfs is used to present independent resource views inside container,
	include cpuinfo, meminfo, stat and so on.
```

## kernel/tkernel/Kconfig
```kconfig
# SPDX-License-Identifier: GPL-2.0-only
#
# TKernel configuration
#
menuconfig TKERNEL
	bool "Tencent Kernel Features"
	default n

if TKERNEL

config TKERNEL_NONPRIV_NETBIND
	bool "Allow non-privileged user to bind specific low ports"
	default n

config TKERNEL_TTOOLS
	tristate "Tencent Kernel TTools"
	default n

config TKERNEL_NETATOP
	tristate 'Netatop support'
	default n
	depends on NETFILTER
	help
		Netatop module from TKernel

config TKERNEL_SHIELD_MOUNTS
	bool 'Shield mount'
	default n

endif
```
